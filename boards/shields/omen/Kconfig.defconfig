## boards/shields/omen/Kconfig.defconfig
```kconfig
# Copyright (c) 2020 Ryan Cross
# SPDX-License-Identifier: MIT

if SHIELD_OMEN_LEFT

config ZMK_KEYBOARD_NAME
    default "Omen"

config ZMK_SPLIT_ROLE_CENTRAL
    default y

endif

if SHIELD_OMEN_LEFT || SHIELD_OMEN_RIGHT

config ZMK_SPLIT
    default y

endif
```

## boards/shields/omen/Kconfig.shield
```kconfig
# Copyright (c) 2024 The ZMK Contributors
# SPDX-License-Identifier: MIT

config SHIELD_OMEN_LEFT
    def_bool $(shields_list_contains,omen_left)

config SHIELD_OMEN_RIGHT
    def_bool $(shields_list_contains,omen_right)
```

## config/west.yml
```yaml
manifest:
  remotes:
    - name: maxschipper
      url-base: https://github.com/maxschipper
  projects:
    - name: zmk
      remote: maxschipper
      revision: ae8299ed
      import: app/west.yml
  self:
    path: config
```
